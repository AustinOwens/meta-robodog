## conf/layer.conf
```bitbake
# We have a conf and classes directory, add to BBPATH
BBPATH .= ":${LAYERDIR}"

# We have recipes-* directories, add to BBFILES
BBFILES += "${LAYERDIR}/recipes-*/*/*.bb \
            ${LAYERDIR}/recipes-*/*/*.bbappend"

BBFILE_COLLECTIONS += "meta-robodog"
BBFILE_PATTERN_meta-robodog = "^${LAYERDIR}/"
BBFILE_PRIORITY_meta-robodog = "9"

LAYERDEPENDS_meta-robodog = "core"
LAYERSERIES_COMPAT_meta-robodog = "kirkstone langdale"

# XSA file name (located in meta-robodog/recipes-bsp/hdf/files)
XSA_FILE_NAME = "system.xsa"

# Device tree without extension (located in meta-robodog/recipes-bsp/u-boot/files)
DEVICETREE_NAME = "zynq-zybo-z7_spidev_axi2spi-periph"

# Add these tools to the approved list of tools yocto build system uses. 
# This variable is defined in poky/meta/conf/bitbake.conf
HOSTTOOLS:append = "arm-none-eabi-gcc arm-none-eabi-ar"
```
